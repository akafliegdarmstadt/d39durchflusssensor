## CMakeLists.txt
```
# Find Zephyr. This also loads Zephyr's build system.
cmake_minimum_required(VERSION 3.13.1)

set(BOARD esp32)

find_package(Zephyr)
project(d39_fuel_flow)

# Add application code
target_sources(app PRIVATE 
                src/main.c
                src/nmea.c
                src/d39_gpio/d39_gpio.c
                src/d39_bt/d39_bt.c)
target_include_directories(app PRIVATE src)
```

## prj.conf
```kconfig
# KConfig stuff
#CONFIG_TEST=y
#CONFIG_ZTEST=y

CONFIG_CBPRINTF_FP_SUPPORT=y
CONFIG_CBPRINTF_LIBC_SUBSTS=y

CONFIG_GPIO_ESP32_0=y

CONFIG_BT=y
CONFIG_BT_DEBUG_LOG=y
CONFIG_BT_PERIPHERAL=y
CONFIG_BT_DEVICE_NAME="d39fuel"
CONFIG_BT_GATT_CLIENT=y
#CONFIG_LOG=n
#CONFIG_LOG_BUFFER_SIZE=2048
```

## src/main.c
```c
#include <stdint.h>
#include <zephyr.h>
#include <device.h>
#include <drivers/gpio.h>
#include <sys/printk.h>
#include <logging/log.h>

#include "d39_gpio/d39_gpio.h"
#include "d39_bt/d39_bt.h"
#include "nmea.h"
#include "config.h"


LOG_MODULE_REGISTER(main, 3);

/* DECLARATIONS */
void handle_timer(struct k_timer *dummy);

K_TIMER_DEFINE(update_timer, handle_timer, NULL);

/*
 * Entry Point
 */
void main(void)
{
	int ret = d39_gpio_init();
	if (ret != 0) {
		printk("Failed to initialize GPIO, error %d", ret);
		return;
	}

	printk("Hello World! %s\n", CONFIG_BOARD);

	int err = d39_bt_enable();

	if (err) {
		printk("Bluetooth init failed (err %d)\n", err);
		return;
	}

	k_timer_start(&update_timer, K_SECONDS(1), K_SECONDS(1));
}

/*
 * Reset Tick counter and send update.
 */
void handle_timer(struct k_timer *dummy)
{
	uint32_t tiks = d39_gpio_get_and_reset_ticks();
	double flow_rate =  tiks / TIKSCONF;
	char buf[NMEA_LENGTH] = "";

	nmeaflow_buildmsg(buf, flow_rate);

	printk("Update - %d, %s\n", tiks, buf);

	d39_bt_send_msg( &buf, 15);
}
```

## src/config.h
```c
/* GPIO */
#define SENS_PIN 5

// BLUETOOTH
#define DEVICE_NAME CONFIG_BT_DEVICE_NAME
#define DEVICE_NAME_LEN (sizeof(DEVICE_NAME) - 1)
#define ADV_LEN 12

#define TIKSCONF 8012.0
```

## src/nmea.c
```c
#include "nmea.h"
#include "string.h"
#include "stdio.h"

/* build nmea message for fuel flow sensor */
void nmeaflow_buildmsg(char *buf, double val) {
    
    // create string from value
    char val_str[8] = "";
    snprintfcb(val_str, 8, "%#05.1f", val);
    
    // calculate checksum
    uint8_t cs = nmeaflow_checksum(val_str, 0, strlen(val_str), PFLO_CS_SEED);

    // build complete msg
    snprintfcb(buf, 15, "$PFLO,%s*%2X\n", val_str, cs);
}

/* Calculate Checksum based on sequential XOR operations */
uint8_t nmeaflow_checksum(const char *line, int start_id, int end_id, uint8_t cs_seed) {
    uint8_t cs = cs_seed;

    // XOR each character with checksum
    for (int i=start_id; i<end_id; i++) {
        cs ^= line[i];
    }

    return cs;
}
```

## src/nmea.h
```c
#include "stdint.h"

/* checksum for "PFLO," string part */
#define PFLO_CS_SEED 57
#define NMEA_LENGTH 16

void nmeaflow_buildmsg(char *buf, double val);
uint8_t nmeaflow_checksum(const char *line, int start_id, int end_id, uint8_t cs_seed);
```
