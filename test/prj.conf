## CMakeLists.txt
```
# Find Zephyr. This also loads Zephyr's build system.
cmake_minimum_required(VERSION 3.13.1)

set(BOARD qemu_cortex_m3)

find_package(Zephyr)
project(d39_fuel_flow)

# Add test code
target_sources(app PRIVATE src/main.c ../src/nmea.c)

target_include_directories(app PRIVATE ../src)
```

## prj.conf
```kconfig
# kconfig stuff
CONFIG_TEST=y
CONFIG_ZTEST=y

CONFIG_CBPRINTF_FP_SUPPORT=y
CONFIG_CBPRINTF_LIBC_SUBSTS=y
```

## src/main.c
```c
#include <ztest.h>
#include <nmea.h>

void test_nmeaflow_buildmsg(void)
{
	const char expected[] = "$PFLO,010.0*16\n";
	char buf[NMEA_LENGTH] = "";

	nmeaflow_buildmsg(buf, 10.0);

	zassert_mem_equal(expected, buf, NMEA_LENGTH, "nmeaflow message");

}

void test_main(void)
{
	ztest_test_suite(common,
			 ztest_unit_test(test_nmeaflow_buildmsg)
			 );
	ztest_run_test_suite(common);
}
```
